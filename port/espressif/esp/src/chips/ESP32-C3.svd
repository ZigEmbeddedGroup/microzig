# ESP32-C3 register map
Vendor: ESPRESSIF SYSTEMS (SHANGHAI) CO., LTD.; Series: ESP32-C3; File version: 8
32-bit RISC-V MCU & 2.4 GHz Wi-Fi & Bluetooth 5 (LE)
CPU: RV32IMC r0p0, little endian, no MPU, no FPU, 4 interrupt priority bits
Address unit: 32 bits
Registers are 32-bit, read-write, reset 0x0 unless marked. A register's access mark holds for its fields unless they carry their own. Offsets are from the block's base; lines under a group give offsets from that group; [hi:lo] are bit positions; {n}, {i} and the like mark numbered series; 'fields as' and 'values as' point back to an identical list; <NAME> marks a mode.

## Memory map
0x60000000 UART0 size 0x84 — UART (Universal Asynchronous Receiver-Transmitter) Controller
0x60002000 SPI1 size 0xA8 — SPI (Serial Peripheral Interface) Controller
0x60003000 SPI0 size 0x48 — SPI (Serial Peripheral Interface) Controller
0x60004000 GPIO size 0x31C — General Purpose Input/Output
0x60004F00 GPIOSD size 0x1C — Sigma-Delta Modulation
0x60008000 RTC_CNTL size 0x12C — Real-Time Clock Control
0x60008800 EFUSE size 0x1CC — eFuse Controller
0x60009000 IO_MUX size 0x60 — Input/Output Multiplexer
0x6000C000 UHCI1 size 0x84 — Universal Host Controller Interface
0x60010000 UART1 size 0x84 — UART (Universal Asynchronous Receiver-Transmitter) Controller
0x60013000 I2C0 size 0x90 — I2C (Inter-Integrated Circuit) Controller
0x60014000 UHCI0 size 0x84 — Universal Host Controller Interface
0x60016000 RMT size 0x78 — Remote Control Peripheral
0x60019000 LEDC size 0xB0 — LED Control PWM (Pulse Width Modulation)
0x6001F000 TIMG0 size 0x68 — Timer Group
0x60020000 TIMG1 size 0x68 — Timer Group
0x60023000 SYSTIMER size 0x78 — System Timer
0x60024000 SPI2 size 0x94 — SPI (Serial Peripheral Interface) Controller
0x60026000 APB_CTRL size 0xA0 — Advanced Peripheral Bus Controller
0x60026000 RNG size 0x4 — Hardware random number generator
0x6002B000 TWAI size 0x6C — Two-Wire Automotive Interface
0x6002D000 I2S size 0x5C — I2S (Inter-IC Sound) Controller
0x6003A000 AES size 0xBC — AES (Advanced Encryption Standard) Accelerator
0x6003B000 SHA size 0xB0 — SHA (Secure Hash Algorithm) Accelerator
0x6003C000 RSA size 0x74 — RSA (Rivest Shamir Adleman) Accelerator
0x6003D000 DS size 0xA4C — Digital Signature
0x6003E000 HMAC size 0xA0 — HMAC (Hash-based Message Authentication Code) Accelerator
0x6003F000 DMA size 0x174 — DMA (Direct Memory Access) Controller
0x60040000 APB_SARADC size 0x68 — Successive Approximation Register Analog to Digital Converter
0x60043000 USB_DEVICE size 0x50 — Full-speed USB Serial/JTAG Controller
0x600C0000 SYSTEM size 0xA0
0x600C1000 SENSITIVE size 0x178
0x600C2000 INTERRUPT_CORE0 size 0x19C — Interrupt Core
0x600C4000 EXTMEM size 0x108 — External Memory
0x600CC000 XTS_AES size 0x30 — XTS-AES-128 Flash Encryption
0x600CE000 ASSIST_DEBUG size 0xA0 — Debug Assist

## Interrupts
15 UHCI0
16 GPIO
17 GPIO_NMI (GPIO)
19 SPI2
20 I2S
21 UART0
22 UART1
23 LEDC
24 EFUSE
25 TWAI
26 USB_SERIAL_JTAG (USB_DEVICE)
27 RTC_CORE (RTC_CNTL)
28 RMT
29 I2C_EXT0 (I2C0)
32 TG0_T0_LEVEL (TIMG0)
33 TG0_WDT_LEVEL (TIMG0)
34 TG1_T0_LEVEL (TIMG1)
35 TG1_WDT_LEVEL (TIMG1)
37 SYSTIMER_TARGET0 (SYSTIMER)
38 SYSTIMER_TARGET1 (SYSTIMER)
39 SYSTIMER_TARGET2 (SYSTIMER)
43 APB_ADC (APB_SARADC)
44 DMA_CH0 (DMA)
45 DMA_CH1 (DMA)
46 DMA_CH2 (DMA)
47 RSA
48 AES
49 SHA
54 ASSIST_DEBUG

## AES — AES (Advanced Encryption Standard) Accelerator
Base 0x6003A000
{0x0+4i} KEY_{i} (i=0..7) — Key material key_{i} configure register
  [31:0] KEY_{i} — This bits stores key_{i} that is a part of key material.
{0x20+4i} TEXT_IN_{i} (i=0..3) — source text material text_in_{i} configure register
  [31:0] TEXT_IN_{i} — This bits stores text_in_{i} that is a part of source text material.
{0x30+4i} TEXT_OUT_{i} (i=0..3) — result text material text_out_{i} configure register
  [31:0] TEXT_OUT_{i} — This bits stores text_out_{i} that is a part of result text material.
0x40 MODE — AES Mode register
  [2:0] MODE — This bits decides which one operation mode will be used. 3'd0: AES-EN-128, 3'd1: AES-EN-192, 3'd2: AES-EN-256, 3'd4: AES-DE-128, 3'd5: AES-DE-192, 3'd6: AES-DE-256.
0x44 ENDIAN — AES Endian configure register
  [5:0] ENDIAN — endian. [1:0] key endian, [3:2] text_in endian or in_stream endian, [5:4] text_out endian or out_stream endian
0x48 TRIGGER wo — AES trigger register
  [0] TRIGGER — Set this bit to start AES calculation.
0x4C STATE ro — AES state register
  [1:0] STATE — Those bits shows AES status. For typical AES, 0: idle, 1: busy. For DMA-AES, 0: idle, 1: busy, 2: calculation_done.
{0x50+i} IV_MEM[{i}] (i=0..15) 8-bit access not given — The memory that stores initialization vector
{0x60+i} H_MEM[{i}] (i=0..15) 8-bit access not given — The memory that stores GCM hash subkey
{0x70+i} J0_MEM[{i}] (i=0..15) 8-bit access not given — The memory that stores J0
{0x80+i} T0_MEM[{i}] (i=0..15) 8-bit access not given — The memory that stores T0
0x90 DMA_ENABLE — DMA-AES working mode register
  [0] DMA_ENABLE — 1'b0: typical AES working mode, 1'b1: DMA-AES working mode.
0x94 BLOCK_MODE — AES cipher block mode register
  [2:0] BLOCK_MODE — Those bits decides which block mode will be used. 0x0: ECB, 0x1: CBC, 0x2: OFB, 0x3: CTR, 0x4: CFB-8, 0x5: CFB-128, 0x6: GCM, 0x7: reserved.
0x98 BLOCK_NUM — AES block number register
  [31:0] BLOCK_NUM — Those bits stores the number of Plaintext/ciphertext block.
0x9C INC_SEL — Standard incrementing function configure register
  [0] INC_SEL — This bit decides the standard incrementing function. 0: INC32. 1: INC128.
0xA0 AAD_BLOCK_NUM — Additional Authential Data block number register
  [31:0] AAD_BLOCK_NUM — Those bits stores the number of AAD block.
0xA4 REMAINDER_BIT_NUM — AES remainder bit number register
  [6:0] REMAINDER_BIT_NUM — Those bits stores the number of remainder bit.
0xA8 CONTINUE wo — AES continue register
  [0] CONTINUE — Set this bit to continue GCM operation.
0xAC INT_CLEAR wo — AES Interrupt clear register
  [0] INT_CLEAR — Set this bit to clear the AES interrupt.
0xB0 INT_ENA — AES Interrupt enable register
  [0] INT_ENA — Set this bit to enable interrupt that occurs when DMA-AES calculation is done.
0xB4 DATE reset 0x20191210 — AES version control register
  [29:0] DATE — This bits stores the version information of AES.
0xB8 DMA_EXIT wo — AES-DMA exit config
  [0] DMA_EXIT — Set this register to leave calculation done stage. Recommend to use it after software finishes reading DMA's output buffer.

## Licence text in the file
Copyright 2022 Espressif Systems (Shanghai) PTE LTD Licensed under the Apache License, Version 2.0 (the "License"); you may not use this file except in compliance with the License. You may obtain a copy of the License at http://www.apache.org/licenses/LICENSE-2.0 Unless required by applicable law or agreed to in writing, software distributed under the License is distributed on an "AS IS" BASIS, WITHOUT WARRANTIES OR CONDITIONS OF ANY KIND, either express or implied. See the License for the specific language governing permissions and limitations under the License.
