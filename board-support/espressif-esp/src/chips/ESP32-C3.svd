# ESP32-C3 register map
Vendor: ESPRESSIF SYSTEMS (SHANGHAI) CO., LTD.; Series: ESP32 C-Series; File version: 18
CPU: RV32IMC r0p0, little endian, no MPU, no FPU, 0 interrupt priority bits
Address unit: 32 bits
Registers are 32-bit, read-write, reset 0x0 unless marked. A register's access mark holds for its fields unless they carry their own. Offsets are from the block's base; [hi:lo] are bit positions; {n}, {i} and the like mark numbered series.

## INTERRUPT_CORE0 — Interrupt Controller (Core 0)
Base 0x600C2000
0x00 MAC_INTR_MAP
  [4:0] MAC_INTR_MAP — core0_mac_intr_map
0x04 MAC_NMI_MAP — mac nmi_intr map register
  [4:0] MAC_NMI_MAP — reg_core0_mac_nmi_map
0x08 PWR_INTR_MAP
  [4:0] PWR_INTR_MAP — reg_core0_pwr_intr_map
0x0C BB_INT_MAP — bb intr map register
  [4:0] BB_INT_MAP — reg_core0_bb_int_map
0x10 BT_MAC_INT_MAP — bt intr map register
  [4:0] BT_MAC_INT_MAP — reg_core0_bt_mac_int_map
0x14 BT_BB_INT_MAP — bb_bt intr map register
  [4:0] BT_BB_INT_MAP — reg_core0_bt_bb_int_map
0x18 BT_BB_NMI_MAP — bb_bt_nmi intr map register
  [4:0] BT_BB_NMI_MAP — reg_core0_bt_bb_nmi_map
0x1C RWBT_IRQ_MAP — rwbt intr map register
  [4:0] RWBT_IRQ_MAP — reg_core0_rwbt_irq_map
0x20 RWBLE_IRQ_MAP — rwble intr map register
  [4:0] RWBLE_IRQ_MAP — reg_core0_rwble_irq_map
0x24 RWBT_NMI_MAP — rwbt_nmi intr map register
  [4:0] RWBT_NMI_MAP — reg_core0_rwbt_nmi_map
0x28 RWBLE_NMI_MAP — rwble_nmi intr map register
  [4:0] RWBLE_NMI_MAP — reg_core0_rwble_nmi_map
0x2C I2C_MST_INT_MAP — i2c intr map register
  [4:0] I2C_MST_INT_MAP — reg_core0_i2c_mst_int_map
0x30 SLC0_INTR_MAP
  [4:0] SLC0_INTR_MAP — reg_core0_slc0_intr_map
0x34 SLC1_INTR_MAP
  [4:0] SLC1_INTR_MAP — reg_core0_slc1_intr_map
0x38 APB_CTRL_INTR_MAP
  [4:0] APB_CTRL_INTR_MAP — reg_core0_apb_ctrl_intr_map
0x3C UHCI0_INTR_MAP — uchi0 intr map register
  [4:0] UHCI0_INTR_MAP — reg_core0_uhci0_intr_map
0x40 GPIO_INTERRUPT_PRO_MAP — gpio intr map register
  [4:0] GPIO_INTERRUPT_PRO_MAP — reg_core0_gpio_interrupt_pro_map
0x44 GPIO_INTERRUPT_PRO_NMI_MAP — gpio_pro intr map register
  [4:0] GPIO_INTERRUPT_PRO_NMI_MAP — reg_core0_gpio_interrupt_pro_nmi_map
0x48 SPI_INTR_1_MAP — gpio_pro_nmi intr map register
  [4:0] SPI_INTR_1_MAP — reg_core0_spi_intr_1_map
0x4C SPI_INTR_2_MAP — spi1 intr map register
  [4:0] SPI_INTR_2_MAP — reg_core0_spi_intr_2_map
0x50 I2S1_INT_MAP — spi2 intr map register
  [4:0] I2S1_INT_MAP — reg_core0_i2s1_int_map
0x54 UART_INTR_MAP — i2s1 intr map register
  [4:0] UART_INTR_MAP — reg_core0_uart_intr_map
0x58 UART1_INTR_MAP
  [4:0] UART1_INTR_MAP — reg_core0_uart1_intr_map
0x5C LEDC_INT_MAP — ledc intr map register
  [4:0] LEDC_INT_MAP — reg_core0_ledc_int_map
0x60 EFUSE_INT_MAP — efuse intr map register
  [4:0] EFUSE_INT_MAP — reg_core0_efuse_int_map
0x64 CAN_INT_MAP — can intr map register
  [4:0] CAN_INT_MAP — reg_core0_can_int_map
0x68 USB_INTR_MAP
  [4:0] USB_INTR_MAP — reg_core0_usb_intr_map
0x6C RTC_CORE_INTR_MAP — rtc intr map register
  [4:0] RTC_CORE_INTR_MAP — reg_core0_rtc_core_intr_map
0x70 RMT_INTR_MAP
  [4:0] RMT_INTR_MAP — reg_core0_rmt_intr_map
0x74 I2C_EXT0_INTR_MAP — i2c intr map register
  [4:0] I2C_EXT0_INTR_MAP — reg_core0_i2c_ext0_intr_map
0x78 TIMER_INT1_MAP — timer1 intr map register
  [4:0] TIMER_INT1_MAP — reg_core0_timer_int1_map
0x7C TIMER_INT2_MAP — timer2 intr map register
  [4:0] TIMER_INT2_MAP — reg_core0_timer_int2_map
0x80 TG_T0_INT_MAP — tg to intr map register
  [4:0] TG_T0_INT_MAP — reg_core0_tg_t0_int_map
0x84 TG_WDT_INT_MAP — tg wdt intr map register
  [4:0] TG_WDT_INT_MAP — reg_core0_tg_wdt_int_map
0x88 TG1_T0_INT_MAP — tg1 to intr map register
  [4:0] TG1_T0_INT_MAP — reg_core0_tg1_t0_int_map
0x8C TG1_WDT_INT_MAP — tg1 wdt intr map register
  [4:0] TG1_WDT_INT_MAP — reg_core0_tg1_wdt_int_map
0x90 CACHE_IA_INT_MAP — cache ia intr map register
  [4:0] CACHE_IA_INT_MAP — reg_core0_cache_ia_int_map
0x94 SYSTIMER_TARGET0_INT_MAP — systimer intr map register
  [4:0] SYSTIMER_TARGET0_INT_MAP — reg_core0_systimer_target0_int_map
0x98 SYSTIMER_TARGET1_INT_MAP — systimer target1 intr map register
  [4:0] SYSTIMER_TARGET1_INT_MAP — reg_core0_systimer_target1_int_map
0x9C SYSTIMER_TARGET2_INT_MAP — systimer target2 intr map register
  [4:0] SYSTIMER_TARGET2_INT_MAP — reg_core0_systimer_target2_int_map
0xA0 SPI_MEM_REJECT_INTR_MAP
  [4:0] SPI_MEM_REJECT_INTR_MAP — reg_core0_spi_mem_reject_intr_map
0xA4 ICACHE_PRELOAD_INT_MAP — icache perload intr map register
  [4:0] ICACHE_PRELOAD_INT_MAP — reg_core0_icache_preload_int_map
0xA8 ICACHE_SYNC_INT_MAP — icache sync intr map register
  [4:0] ICACHE_SYNC_INT_MAP — reg_core0_icache_sync_int_map
0xAC APB_ADC_INT_MAP — adc intr map register
  [4:0] APB_ADC_INT_MAP — reg_core0_apb_adc_int_map
{0xB0+4i} DMA_CH{i}_INT_MAP (i=0..2) — dma ch{i} intr map register
  [4:0] DMA_CH{i}_INT_MAP — reg_core0_dma_ch{i}_int_map
0xBC RSA_INT_MAP — rsa intr map register
  [4:0] RSA_INT_MAP — reg_core0_rsa_int_map
0xC0 AES_INT_MAP — aes intr map register
  [4:0] AES_INT_MAP — reg_core0_aes_int_map
0xC4 SHA_INT_MAP — sha intr map register
  [4:0] SHA_INT_MAP — reg_core0_sha_int_map
0xC8 CPU_INTR_FROM_CPU_0_MAP — cpu from cpu 0 intr map register
  [4:0] CPU_INTR_FROM_CPU_0_MAP — reg_core0_cpu_intr_from_cpu_0_map
0xCC CPU_INTR_FROM_CPU_1_MAP — cpu from cpu 0 intr map register
  [4:0] CPU_INTR_FROM_CPU_1_MAP — reg_core0_cpu_intr_from_cpu_1_map
0xD0 CPU_INTR_FROM_CPU_2_MAP — cpu from cpu 1 intr map register
  [4:0] CPU_INTR_FROM_CPU_2_MAP — reg_core0_cpu_intr_from_cpu_2_map
0xD4 CPU_INTR_FROM_CPU_3_MAP — cpu from cpu 3 intr map register
  [4:0] CPU_INTR_FROM_CPU_3_MAP — reg_core0_cpu_intr_from_cpu_3_map
0xD8 ASSIST_DEBUG_INTR_MAP
  [4:0] ASSIST_DEBUG_INTR_MAP — reg_core0_assist_debug_intr_map
0xDC DMA_APBPERI_PMS_MONITOR_VIOLATE_INTR_MAP — dma pms violatile intr map register
  [4:0] DMA_APBPERI_PMS_MONITOR_VIOLATE_INTR_MAP — reg_core0_dma_apbperi_pms_monitor_violate_intr_map
0xE0 CORE_0_IRAM0_PMS_MONITOR_VIOLATE_INTR_MAP — iram0 pms violatile intr map register
  [4:0] CORE_0_IRAM0_PMS_MONITOR_VIOLATE_INTR_MAP — reg_core0_core_0_iram0_pms_monitor_violate_intr_map
0xE4 CORE_0_DRAM0_PMS_MONITOR_VIOLATE_INTR_MAP — mac intr map register
  [4:0] CORE_0_DRAM0_PMS_MONITOR_VIOLATE_INTR_MAP — reg_core0_core_0_dram0_pms_monitor_violate_intr_map
0xE8 CORE_0_PIF_PMS_MONITOR_VIOLATE_INTR_MAP — mac intr map register
  [4:0] CORE_0_PIF_PMS_MONITOR_VIOLATE_INTR_MAP — reg_core0_core_0_pif_pms_monitor_violate_intr_map
0xEC CORE_0_PIF_PMS_MONITOR_VIOLATE_SIZE_INTR_MAP — mac intr map register
  [4:0] CORE_0_PIF_PMS_MONITOR_VIOLATE_SIZE_INTR_MAP — reg_core0_core_0_pif_pms_monitor_violate_size_intr_map
0xF0 BACKUP_PMS_VIOLATE_INTR_MAP — mac intr map register
  [4:0] BACKUP_PMS_VIOLATE_INTR_MAP — reg_core0_backup_pms_violate_intr_map
0xF4 CACHE_CORE0_ACS_INT_MAP — mac intr map register
  [4:0] CACHE_CORE0_ACS_INT_MAP — reg_core0_cache_core0_acs_int_map
0xF8 INTR_STATUS_REG_0 ro — mac intr map register
  [31:0] INTR_STATUS_0 — reg_core0_intr_status_0
0xFC INTR_STATUS_REG_1 ro — mac intr map register
  [31:0] INTR_STATUS_1 — reg_core0_intr_status_1
0x100 CLOCK_GATE reset 0x1 — mac intr map register
  [0] REG_CLK_EN — reg_core0_reg_clk_en
0x104 CPU_INT_ENABLE — mac intr map register
  [31:0] CPU_INT_ENABLE — reg_core0_cpu_int_enable
0x108 CPU_INT_TYPE — mac intr map register
  [31:0] CPU_INT_TYPE — reg_core0_cpu_int_type
0x10C CPU_INT_CLEAR — mac intr map register
  [31:0] CPU_INT_CLEAR — reg_core0_cpu_int_clear
0x110 CPU_INT_EIP_STATUS ro — mac intr map register
  [31:0] CPU_INT_EIP_STATUS — reg_core0_cpu_int_eip_status
{0x114+4i} CPU_INT_PRI_{i} (i=0..31) — mac intr map register
  [3:0] CPU_PRI_{i}_MAP — reg_core0_cpu_pri_{i}_map
0x194 CPU_INT_THRESH — mac intr map register
  [3:0] CPU_INT_THRESH — reg_core0_cpu_int_thresh
0x7FC INTERRUPT_REG_DATE reset 0x2007210 — mac intr map register
  [27:0] INTERRUPT_REG_DATE — reg_core0_interrupt_reg_date
